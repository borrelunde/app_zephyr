## CMakeLists.txt
```
cmake_minimum_required(VERSION 3.20.0)

find_package(Zephyr REQUIRED HINTS $ENV{ZEPHYR_BASE})
project(application)

target_sources(app PRIVATE src/main.c)
```

## prj.conf
```kconfig
# Global switch, turns on/off the logging.
CONFIG_LOG=y

# Enables coloring of errors (red) and warnings (yellow).
CONFIG_LOG_BACKEND_SHOW_COLOR=n

# Default level, sets the logging level used by modules that are not setting 
# their own logging level.
# The log levels are: 0 off, 1 error, 2 warning, 3 info, 4 debug
CONFIG_LOG_DEFAULT_LEVEL=3
```

## src/main.c
```c
#include <zephyr/kernel.h>
#include <zephyr/logging/log.h>

LOG_MODULE_REGISTER(main, LOG_LEVEL_DBG);

int main(void) {
    printk("Hello World from %s!\n", CONFIG_BOARD);
    LOG_DBG("Hello World from %s!", CONFIG_BOARD);
    LOG_INF("Hello World from %s!", CONFIG_BOARD);
    LOG_WRN("Hello World from %s!", CONFIG_BOARD);
    LOG_ERR("Hello World from %s!", CONFIG_BOARD);
    return 0;
}
```
